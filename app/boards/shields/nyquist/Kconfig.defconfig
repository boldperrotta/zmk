## app/boards/shields/nyquist/Kconfig.defconfig
```kconfig
# Copyright (c) 2020 Pete Johanson, Kurtis Lew
# SPDX-License-Identifier: MIT

if SHIELD_NYQUIST_LEFT

config ZMK_KEYBOARD_NAME
	default "Nyquist Left"

endif

if SHIELD_NYQUIST_RIGHT

config ZMK_KEYBOARD_NAME
	default "Nyquist Right"

endif
```

## app/boards/shields/nyquist/Kconfig.shield
```kconfig
# Copyright (c) 2020 Pete Johanson, Kurtis Lew
# SPDX-License-Identifier: MIT

config SHIELD_NYQUIST_LEFT
	def_bool $(shields_list_contains,nyquist_left)

config SHIELD_NYQUIST_RIGHT
	def_bool $(shields_list_contains,nyquist_right)
```
